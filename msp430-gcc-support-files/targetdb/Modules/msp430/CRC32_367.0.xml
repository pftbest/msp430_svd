# CRC32_367.0 register map
Vendor: Texas Instruments
Peripheral module from a debugger description file (folder msp430).
Registers are 16-bit, access not given, no defined reset value unless marked. A register's access mark holds for its fields unless they carry their own. Offsets are as the file gives them; lines under a group give offsets from that group; [hi:lo] are bit positions; {n}, {i} and the like mark numbered series; 'fields as' and 'values as' point back to an identical list; <NAME> marks a mode.

## CRC32
0x00 CRC32DIW0 — CRC32 Data Input Word 0
0x02 CRC32DIW1 — CRC32 Data Input Word 1
0x04 CRC32DIRBW1 — CRC32 Data In Reverse Word 1
0x06 CRC32DIRBW0 — CRC32 Data In Reverse Word 0
0x08 CRC32INIRESW0 — CRC32 Initialization and Result Word 0
0x0A CRC32INIRESW1 — CRC32 Initialization and Result Word 1
0x0C CRC32RESRW1 — CRC32 Result Reverse Word 1
0x0E CRC32RESRW0 — CRC32 Result Reverse Word 0
0x10 CRC16DIW0 — CRC16 Data Input
0x16 CRC16DIRBW0 — CRC16 Data In Reverse
0x18 CRC16INIRESW0 — CRC16 Init and Result
0x1E CRC16RESRW0 — CRC16 Result Reverse
