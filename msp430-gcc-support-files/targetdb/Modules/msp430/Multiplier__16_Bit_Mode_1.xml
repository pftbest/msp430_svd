# Multiplier__16_Bit_Mode_1 register map
Vendor: Texas Instruments
Peripheral module from a debugger description file (folder msp430).
Registers are 16-bit, access not given, no defined reset value unless marked. A register's access mark holds for its fields unless they carry their own. Offsets are as the file gives them; lines under a group give offsets from that group; [hi:lo] are bit positions; {n}, {i} and the like mark numbered series; 'fields as' and 'values as' point back to an identical list; <NAME> marks a mode.

## Multiplier_16_Bit_Mode
0x130 MPY_B 8-bit — Multiply Unsigned/Operand 1 (Byte Access)
0x130 MPY — Multiply Unsigned/Operand 1
0x132 MPYS_B 8-bit — Multiply Signed/Operand 1 (Byte Access)
0x132 MPYS — Multiply Signed/Operand 1
0x134 MAC_B 8-bit — Multiply Unsigned and Accumulate/Operand 1 (Byte Access)
0x134 MAC — Multiply Unsigned and Accumulate/Operand 1
0x136 MACS_B 8-bit — Multiply Signed and Accumulate/Operand 1 (Byte Access)
0x136 MACS — Multiply Signed and Accumulate/Operand 1
0x138 OP2_B 8-bit — Operand 2 (Byte Access)
0x138 OP2 — Operand 2
0x13A RESLO — Result Low Word
0x13C RESHI — Result High Word
0x13E SUMEXT — Sum Extend
