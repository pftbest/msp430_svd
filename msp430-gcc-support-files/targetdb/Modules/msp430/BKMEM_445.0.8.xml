# BKMEM_445.0.8 register map
Vendor: Texas Instruments
Peripheral module from a debugger description file (folder msp430).
Registers are 16-bit, access not given, no defined reset value unless marked. A register's access mark holds for its fields unless they carry their own. Offsets are as the file gives them; lines under a group give offsets from that group; [hi:lo] are bit positions; {n}, {i} and the like mark numbered series; 'fields as' and 'values as' point back to an identical list; <NAME> marks a mode.

## BKMEM
0x00 BAKMEM0 — Backup Memory registers. Backup Memory 0.
{0x0+2i} BAKMEM{i} (i=1..9) — Backup Memory {i}.
0x14 BAKMEM10 — Backup Memory registers. Backup Memory 10.
{0x0+2i} BAKMEM{i} (i=11..15) — Backup Memory {i}.
