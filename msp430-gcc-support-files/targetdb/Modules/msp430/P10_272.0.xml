# P10_272.0 register map
Vendor: Texas Instruments
Peripheral module from a debugger description file (folder msp430).
Registers are 8-bit, access not given, no defined reset value unless marked. A register's access mark holds for its fields unless they carry their own. Offsets are as the file gives them; lines under a group give offsets from that group; [hi:lo] are bit positions; {n}, {i} and the like mark numbered series; 'fields as' and 'values as' point back to an identical list; <NAME> marks a mode.

## P10
0x81 P10IN — Port 10 Input
0x83 P10OUT — Port 10 Output
0x85 P10DIR — Port 10 Direction
0x87 P10REN — Port 10 Resistor Enable
0x8B P10SEL0 — Port 10 Select 0
0x8D P10SEL1 — Port 10 Select 1
0x97 P10SELC — Port 10 Complement Select
0x99 P10IES — Port 10 Interrupt Edge Select
0x9B P10IE — Port 10 Interrupt Enable
0x9D P10IFG — Port 10 Interrupt Flag
