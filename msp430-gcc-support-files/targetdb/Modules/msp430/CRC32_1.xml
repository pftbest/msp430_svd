# CRC32_1 register map
Vendor: Texas Instruments
Peripheral module from a debugger description file (folder msp430).
Registers are 16-bit, access not given, no defined reset value unless marked. A register's access mark holds for its fields unless they carry their own. Offsets are as the file gives them; lines under a group give offsets from that group; [hi:lo] are bit positions; {n}, {i} and the like mark numbered series; 'fields as' and 'values as' point back to an identical list; <NAME> marks a mode.

## CRC32
0x980 CRC32DIW0 — CRC32 Data In
0x982 CRC32DIW1 — CRC32 Data In
0x984 CRC32DIRBW1 — CRC32 Data In Reversed Bit
0x986 CRC32DIRBW0 — CRC32 Data In Reversed Bit
0x988 CRC32INIRESW0 — CRC32 Initialization and Result
0x98A CRC32INIRESW1 — CRC32 Initialization and Result
0x98C CRC32RESRW1 — CRC32 Result Reverse
0x98E CRC32RESRW0 — CRC32 Result Reverse
0x990 CRC16DIW0 — CRC16 Data Input
0x992 CRC16DIW1 — CRC16 Data Input
0x994 CRC16DIRBW1 — CRC16 Data In Reverse
0x996 CRC16DIRBW0 — CRC16 Data In Reverse
0x998 CRC16INIRESW0 — CRC16 Init and Result
0x99C CRC16RESRW1 — CRC16 Result Reverse
0x99E CRC16RESRW0 — CRC16 Result Reverse
