# CRC_208.0 register map
Vendor: Texas Instruments
Peripheral module from a debugger description file (folder msp430).
Registers are 16-bit, access not given, no defined reset value unless marked. A register's access mark holds for its fields unless they carry their own. Offsets are as the file gives them; lines under a group give offsets from that group; [hi:lo] are bit positions; {n}, {i} and the like mark numbered series; 'fields as' and 'values as' point back to an identical list; <NAME> marks a mode.

## CRC
0x00 CRCDI — CRC Data In
0x02 CRCDIRB — CRC Data In Reverse Byte
0x04 CRCINIRES — CRC Initialization and Result
0x06 CRCRESR — CRC Result Reverse
