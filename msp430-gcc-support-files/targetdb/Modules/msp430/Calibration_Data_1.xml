# Calibration_Data_1 register map
Vendor: Texas Instruments
Peripheral module from a debugger description file (folder msp430).
Registers are 8-bit, access not given, no defined reset value unless marked. A register's access mark holds for its fields unless they carry their own. Offsets are as the file gives them; lines under a group give offsets from that group; [hi:lo] are bit positions; {n}, {i} and the like mark numbered series; 'fields as' and 'values as' point back to an identical list; <NAME> marks a mode.

## Calibration_Data
0x10F8 CALDCO_16MHZ — DCOCTL Calibration Data for 16MHz
0x10F9 CALBC1_16MHZ — BCSCTL1 Calibration Data for 16MHz
0x10FA CALDCO_12MHZ — DCOCTL Calibration Data for 12MHz
0x10FB CALBC1_12MHZ — BCSCTL1 Calibration Data for 12MHz
0x10FC CALDCO_8MHZ — DCOCTL Calibration Data for 8MHz
0x10FD CALBC1_8MHZ — BCSCTL1 Calibration Data for 8MHz
0x10FE CALDCO_1MHZ — DCOCTL Calibration Data for 1MHz
0x10FF CALBC1_1MHZ — BCSCTL1 Calibration Data for 1MHz
