# TLV_Calibration_Data_1 register map
Vendor: Texas Instruments
Peripheral module from a debugger description file (folder msp430).
Registers are 8-bit, access not given, no defined reset value unless marked. A register's access mark holds for its fields unless they carry their own. Offsets are as the file gives them; lines under a group give offsets from that group; [hi:lo] are bit positions; {n}, {i} and the like mark numbered series; 'fields as' and 'values as' point back to an identical list; <NAME> marks a mode.

## TLV_Calibration_Data
0x10C0 TLV_CHECKSUM 16-bit
0x10DA TLV_ADC10_1_TAG
0x10DB TLV_ADC10_1_LEN
0x10F6 TLV_DCO_30_TAG — TLV TAG_DCO30 TAG
0x10F7 TLV_DCO_30_LEN — TLV TAG_DCO30 LEN
